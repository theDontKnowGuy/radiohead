## experiments/zephyr-tone/build-left/Kconfig/Kconfig.sysbuild.modules
```kconfig
config ZEPHYR_HAL_ESPRESSIF_MODULE
   bool
   default y
config ZEPHYR_XTENSA_MODULE
   bool
   default y
```

## experiments/zephyr-tone/build-left/Kconfig/soc/Kconfig
```kconfig
# Load Zephyr SoC Kconfig descriptions.
osource "/Users/avner/Documents/Projects/ESP32Projects/radiohead/.pio/zephyr-tone-env/workspace/zephyr/soc/xlnx/zynqmp/Kconfig"
osource "/Users/avner/Documents/Projects/ESP32Projects/radiohead/.pio/zephyr-tone-env/workspace/zephyr/soc/xlnx/zynq7000/Kconfig"
osource "/Users/avner/Documents/Projects/ESP32Projects/radiohead/.pio/zephyr-tone-env/workspace/zephyr/soc/xlnx/versalnet/Kconfig"
osource "/Users/avner/Documents/Projects/ESP32Projects/radiohead/.pio/zephyr-tone-env/workspace/zephyr/soc/xlnx/versal2/Kconfig"
osource "/Users/avner/Documents/Projects/ESP32Projects/radiohead/.pio/zephyr-tone-env/workspace/zephyr/soc/xen/Kconfig"
osource "/Users/avner/Documents/Projects/ESP32Projects/radiohead/.pio/zephyr-tone-env/workspace/zephyr/soc/wch/ch32v/Kconfig"
osource "/Users/avner/Documents/Projects/ESP32Projects/radiohead/.pio/zephyr-tone-env/workspace/zephyr/soc/ti/simplelink/Kconfig"
osource "/Users/avner/Documents/Projects/ESP32Projects/radiohead/.pio/zephyr-tone-env/workspace/zephyr/soc/ti/mspm0/Kconfig"
osource "/Users/avner/Documents/Projects/ESP32Projects/radiohead/.pio/zephyr-tone-env/workspace/zephyr/soc/ti/lm3s6965/Kconfig"
osource "/Users/avner/Documents/Projects/ESP32Projects/radiohead/.pio/zephyr-tone-env/workspace/zephyr/soc/ti/k3/Kconfig"
osource "/Users/avner/Documents/Projects/ESP32Projects/radiohead/.pio/zephyr-tone-env/workspace/zephyr/soc/telink/tlsr/Kconfig"
osource "/Users/avner/Documents/Projects/ESP32Projects/radiohead/.pio/zephyr-tone-env/workspace/zephyr/soc/starfive/jh71xx/Kconfig"
osource "/Users/avner/Documents/Projects/ESP32Projects/radiohead/.pio/zephyr-tone-env/workspace/zephyr/soc/st/stm32/Kconfig"
osource "/Users/avner/Documents/Projects/ESP32Projects/radiohead/.pio/zephyr-tone-env/workspace/zephyr/soc/snps/qemu_arc/Kconfig"
osource "/Users/avner/Documents/Projects/ESP32Projects/radiohead/.pio/zephyr-tone-env/workspace/zephyr/soc/snps/nsim/arc_v/Kconfig"
osource "/Users/avner/Documents/Projects/ESP32Projects/radiohead/.pio/zephyr-tone-env/workspace/zephyr/soc/snps/nsim/arc_classic/Kconfig"
osource "/Users/avner/Documents/Projects/ESP32Projects/radiohead/.pio/zephyr-tone-env/workspace/zephyr/soc/snps/hsdk4xd/Kconfig"
osource "/Users/avner/Documents/Projects/ESP32Projects/radiohead/.pio/zephyr-tone-env/workspace/zephyr/soc/snps/hsdk/Kconfig"
osource "/Users/avner/Documents/Projects/ESP32Projects/radiohead/.pio/zephyr-tone-env/workspace/zephyr/soc/snps/emsk/Kconfig"
osource "/Users/avner/Documents/Projects/ESP32Projects/radiohead/.pio/zephyr-tone-env/workspace/zephyr/soc/snps/emsdp/Kconfig"
osource "/Users/avner/Documents/Projects/ESP32Projects/radiohead/.pio/zephyr-tone-env/workspace/zephyr/soc/snps/arc_iot/Kconfig"
osource "/Users/avner/Documents/Projects/ESP32Projects/radiohead/.pio/zephyr-tone-env/workspace/zephyr/soc/silabs/Kconfig"
osource "/Users/avner/Documents/Projects/ESP32Projects/radiohead/.pio/zephyr-tone-env/workspace/zephyr/soc/sifive/sifive_freedom/Kconfig"
osource "/Users/avner/Documents/Projects/ESP32Projects/radiohead/.pio/zephyr-tone-env/workspace/zephyr/soc/sensry/Kconfig"
osource "/Users/avner/Documents/Projects/ESP32Projects/radiohead/.pio/zephyr-tone-env/workspace/zephyr/soc/rockchip/Kconfig"
osource "/Users/avner/Documents/Projects/ESP32Projects/radiohead/.pio/zephyr-tone-env/workspace/zephyr/soc/renode/riscv_virtual/Kconfig"
osource "/Users/avner/Documents/Projects/ESP32Projects/radiohead/.pio/zephyr-tone-env/workspace/zephyr/soc/renode/cortex_r8_virtual/Kconfig"
osource "/Users/avner/Documents/Projects/ESP32Projects/radiohead/.pio/zephyr-tone-env/workspace/zephyr/soc/renesas/smartbond/Kconfig"
osource "/Users/avner/Documents/Projects/ESP32Projects/radiohead/.pio/zephyr-tone-env/workspace/zephyr/soc/renesas/rz/Kconfig"
osource "/Users/avner/Documents/Projects/ESP32Projects/radiohead/.pio/zephyr-tone-env/workspace/zephyr/soc/renesas/rx/Kconfig"
osource "/Users/avner/Documents/Projects/ESP32Projects/radiohead/.pio/zephyr-tone-env/workspace/zephyr/soc/renesas/rcar/Kconfig"
osource "/Users/avner/Documents/Projects/ESP32Projects/radiohead/.pio/zephyr-tone-env/workspace/zephyr/soc/renesas/ra/Kconfig"
osource "/Users/avner/Documents/Projects/ESP32Projects/radiohead/.pio/zephyr-tone-env/workspace/zephyr/soc/realtek/ec/Kconfig"
osource "/Users/avner/Documents/Projects/ESP32Projects/radiohead/.pio/zephyr-tone-env/workspace/zephyr/soc/raspberrypi/rpi_pico/Kconfig"
osource "/Users/avner/Documents/Projects/ESP32Projects/radiohead/.pio/zephyr-tone-env/workspace/zephyr/soc/quicklogic/eos_s3/Kconfig"
osource "/Users/avner/Documents/Projects/ESP32Projects/radiohead/.pio/zephyr-tone-env/workspace/zephyr/soc/qemu/virt_riscv/Kconfig"
osource "/Users/avner/Documents/Projects/ESP32Projects/radiohead/.pio/zephyr-tone-env/workspace/zephyr/soc/qemu/malta/Kconfig"
osource "/Users/avner/Documents/Projects/ESP32Projects/radiohead/.pio/zephyr-tone-env/workspace/zephyr/soc/openisa/rv32m1/Kconfig"
osource "/Users/avner/Documents/Projects/ESP32Projects/radiohead/.pio/zephyr-tone-env/workspace/zephyr/soc/openhwgroup/cva6/Kconfig"
osource "/Users/avner/Documents/Projects/ESP32Projects/radiohead/.pio/zephyr-tone-env/workspace/zephyr/soc/oct/osd32mp15x/Kconfig"
osource "/Users/avner/Documents/Projects/ESP32Projects/radiohead/.pio/zephyr-tone-env/workspace/zephyr/soc/nxp/s32/Kconfig"
osource "/Users/avner/Documents/Projects/ESP32Projects/radiohead/.pio/zephyr-tone-env/workspace/zephyr/soc/nxp/rw/Kconfig"
osource "/Users/avner/Documents/Projects/ESP32Projects/radiohead/.pio/zephyr-tone-env/workspace/zephyr/soc/nxp/mcx/Kconfig"
osource "/Users/avner/Documents/Projects/ESP32Projects/radiohead/.pio/zephyr-tone-env/workspace/zephyr/soc/nxp/lpc/Kconfig"
osource "/Users/avner/Documents/Projects/ESP32Projects/radiohead/.pio/zephyr-tone-env/workspace/zephyr/soc/nxp/layerscape/Kconfig"
osource "/Users/avner/Documents/Projects/ESP32Projects/radiohead/.pio/zephyr-tone-env/workspace/zephyr/soc/nxp/kinetis/Kconfig"
osource "/Users/avner/Documents/Projects/ESP32Projects/radiohead/.pio/zephyr-tone-env/workspace/zephyr/soc/nxp/imxrt/Kconfig"
osource "/Users/avner/Documents/Projects/ESP32Projects/radiohead/.pio/zephyr-tone-env/workspace/zephyr/soc/nxp/imx/Kconfig"
osource "/Users/avner/Documents/Projects/ESP32Projects/radiohead/.pio/zephyr-tone-env/workspace/zephyr/soc/nuvoton/numicro/Kconfig"
osource "/Users/avner/Documents/Projects/ESP32Projects/radiohead/.pio/zephyr-tone-env/workspace/zephyr/soc/nuvoton/numaker/Kconfig"
osource "/Users/avner/Documents/Projects/ESP32Projects/radiohead/.pio/zephyr-tone-env/workspace/zephyr/soc/nuvoton/npcx/Kconfig"
osource "/Users/avner/Documents/Projects/ESP32Projects/radiohead/.pio/zephyr-tone-env/workspace/zephyr/soc/nuvoton/npcm/Kconfig"
osource "/Users/avner/Documents/Projects/ESP32Projects/radiohead/.pio/zephyr-tone-env/workspace/zephyr/soc/nordic/Kconfig"
osource "/Users/avner/Documents/Projects/ESP32Projects/radiohead/.pio/zephyr-tone-env/workspace/zephyr/soc/neorv32/Kconfig"
osource "/Users/avner/Documents/Projects/ESP32Projects/radiohead/.pio/zephyr-tone-env/workspace/zephyr/soc/native/inf_clock/Kconfig"
osource "/Users/avner/Documents/Projects/ESP32Projects/radiohead/.pio/zephyr-tone-env/workspace/zephyr/soc/microchip/sam/Kconfig"
osource "/Users/avner/Documents/Projects/ESP32Projects/radiohead/.pio/zephyr-tone-env/workspace/zephyr/soc/microchip/miv/Kconfig"
osource "/Users/avner/Documents/Projects/ESP32Projects/radiohead/.pio/zephyr-tone-env/workspace/zephyr/soc/microchip/mec/Kconfig"
osource "/Users/avner/Documents/Projects/ESP32Projects/radiohead/.pio/zephyr-tone-env/workspace/zephyr/soc/mediatek/mt8xxx/Kconfig"
osource "/Users/avner/Documents/Projects/ESP32Projects/radiohead/.pio/zephyr-tone-env/workspace/zephyr/soc/lowrisc/opentitan/Kconfig"
osource "/Users/avner/Documents/Projects/ESP32Projects/radiohead/.pio/zephyr-tone-env/workspace/zephyr/soc/litex/litex_vexriscv/Kconfig"
osource "/Users/avner/Documents/Projects/ESP32Projects/radiohead/.pio/zephyr-tone-env/workspace/zephyr/soc/ite/ec/Kconfig"
osource "/Users/avner/Documents/Projects/ESP32Projects/radiohead/.pio/zephyr-tone-env/workspace/zephyr/soc/intel/raptor_lake/Kconfig"
osource "/Users/avner/Documents/Projects/ESP32Projects/radiohead/.pio/zephyr-tone-env/workspace/zephyr/soc/intel/lakemont/Kconfig"
osource "/Users/avner/Documents/Projects/ESP32Projects/radiohead/.pio/zephyr-tone-env/workspace/zephyr/soc/intel/intel_socfpga_std/Kconfig"
osource "/Users/avner/Documents/Projects/ESP32Projects/radiohead/.pio/zephyr-tone-env/workspace/zephyr/soc/intel/intel_socfpga/Kconfig"
osource "/Users/avner/Documents/Projects/ESP32Projects/radiohead/.pio/zephyr-tone-env/workspace/zephyr/soc/intel/intel_niosv/Kconfig"
osource "/Users/avner/Documents/Projects/ESP32Projects/radiohead/.pio/zephyr-tone-env/workspace/zephyr/soc/intel/intel_ish/Kconfig"
osource "/Users/avner/Documents/Projects/ESP32Projects/radiohead/.pio/zephyr-tone-env/workspace/zephyr/soc/intel/intel_adsp/Kconfig"
osource "/Users/avner/Documents/Projects/ESP32Projects/radiohead/.pio/zephyr-tone-env/workspace/zephyr/soc/intel/elkhart_lake/Kconfig"
osource "/Users/avner/Documents/Projects/ESP32Projects/radiohead/.pio/zephyr-tone-env/workspace/zephyr/soc/intel/atom/Kconfig"
osource "/Users/avner/Documents/Projects/ESP32Projects/radiohead/.pio/zephyr-tone-env/workspace/zephyr/soc/intel/apollo_lake/Kconfig"
osource "/Users/avner/Documents/Projects/ESP32Projects/radiohead/.pio/zephyr-tone-env/workspace/zephyr/soc/intel/alder_lake/Kconfig"
osource "/Users/avner/Documents/Projects/ESP32Projects/radiohead/.pio/zephyr-tone-env/workspace/zephyr/soc/infineon/cat3/Kconfig"
osource "/Users/avner/Documents/Projects/ESP32Projects/radiohead/.pio/zephyr-tone-env/workspace/zephyr/soc/infineon/cat1c/Kconfig"
osource "/Users/avner/Documents/Projects/ESP32Projects/radiohead/.pio/zephyr-tone-env/workspace/zephyr/soc/infineon/cat1b/Kconfig"
osource "/Users/avner/Documents/Projects/ESP32Projects/radiohead/.pio/zephyr-tone-env/workspace/zephyr/soc/infineon/cat1a/Kconfig"
osource "/Users/avner/Documents/Projects/ESP32Projects/radiohead/.pio/zephyr-tone-env/workspace/zephyr/soc/gd/gd32/Kconfig"
osource "/Users/avner/Documents/Projects/ESP32Projects/radiohead/.pio/zephyr-tone-env/workspace/zephyr/soc/gaisler/leon3/Kconfig"
osource "/Users/avner/Documents/Projects/ESP32Projects/radiohead/.pio/zephyr-tone-env/workspace/zephyr/soc/gaisler/gr716a/Kconfig"
osource "/Users/avner/Documents/Projects/ESP32Projects/radiohead/.pio/zephyr-tone-env/workspace/zephyr/soc/espressif/Kconfig"
osource "/Users/avner/Documents/Projects/ESP32Projects/radiohead/.pio/zephyr-tone-env/workspace/zephyr/soc/ene/kb1200/Kconfig"
osource "/Users/avner/Documents/Projects/ESP32Projects/radiohead/.pio/zephyr-tone-env/workspace/zephyr/soc/ene/kb106x/Kconfig"
osource "/Users/avner/Documents/Projects/ESP32Projects/radiohead/.pio/zephyr-tone-env/workspace/zephyr/soc/efinix/sapphire/Kconfig"
osource "/Users/avner/Documents/Projects/ESP32Projects/radiohead/.pio/zephyr-tone-env/workspace/zephyr/soc/cdns/xtensa_sample_controller/Kconfig"
osource "/Users/avner/Documents/Projects/ESP32Projects/radiohead/.pio/zephyr-tone-env/workspace/zephyr/soc/cdns/sample_controller32/Kconfig"
osource "/Users/avner/Documents/Projects/ESP32Projects/radiohead/.pio/zephyr-tone-env/workspace/zephyr/soc/cdns/dc233c/Kconfig"
osource "/Users/avner/Documents/Projects/ESP32Projects/radiohead/.pio/zephyr-tone-env/workspace/zephyr/soc/brcm/bcmvk/Kconfig"
osource "/Users/avner/Documents/Projects/ESP32Projects/radiohead/.pio/zephyr-tone-env/workspace/zephyr/soc/brcm/bcm2712/Kconfig"
osource "/Users/avner/Documents/Projects/ESP32Projects/radiohead/.pio/zephyr-tone-env/workspace/zephyr/soc/brcm/bcm2711/Kconfig"
osource "/Users/avner/Documents/Projects/ESP32Projects/radiohead/.pio/zephyr-tone-env/workspace/zephyr/soc/bflb/Kconfig"
osource "/Users/avner/Documents/Projects/ESP32Projects/radiohead/.pio/zephyr-tone-env/workspace/zephyr/soc/atmel/sam0/Kconfig"
osource "/Users/avner/Documents/Projects/ESP32Projects/radiohead/.pio/zephyr-tone-env/workspace/zephyr/soc/atmel/sam/Kconfig"
osource "/Users/avner/Documents/Projects/ESP32Projects/radiohead/.pio/zephyr-tone-env/workspace/zephyr/soc/aspeed/Kconfig"
osource "/Users/avner/Documents/Projects/ESP32Projects/radiohead/.pio/zephyr-tone-env/workspace/zephyr/soc/arm/Kconfig"
osource "/Users/avner/Documents/Projects/ESP32Projects/radiohead/.pio/zephyr-tone-env/workspace/zephyr/soc/arm/beetle/Kconfig"
osource "/Users/avner/Documents/Projects/ESP32Projects/radiohead/.pio/zephyr-tone-env/workspace/zephyr/soc/antmicro/myra/Kconfig"
osource "/Users/avner/Documents/Projects/ESP32Projects/radiohead/.pio/zephyr-tone-env/workspace/zephyr/soc/andestech/Kconfig"
osource "/Users/avner/Documents/Projects/ESP32Projects/radiohead/.pio/zephyr-tone-env/workspace/zephyr/soc/amd/acp_6_0/Kconfig"
osource "/Users/avner/Documents/Projects/ESP32Projects/radiohead/.pio/zephyr-tone-env/workspace/zephyr/soc/ambiq/Kconfig"
osource "/Users/avner/Documents/Projects/ESP32Projects/radiohead/.pio/zephyr-tone-env/workspace/zephyr/soc/aesc/Kconfig"
osource "/Users/avner/Documents/Projects/ESP32Projects/radiohead/.pio/zephyr-tone-env/workspace/zephyr/soc/adi/max32/Kconfig"
```

## experiments/zephyr-tone/build-right/Kconfig/Kconfig.modules
```kconfig
menu "hal_espressif (/Users/avner/Documents/Projects/ESP32Projects/radiohead/.pio/zephyr-tone-env/workspace/modules/hal/espressif)"
osource "/Users/avner/Documents/Projects/ESP32Projects/radiohead/.pio/zephyr-tone-env/workspace/modules/hal/espressif/zephyr/Kconfig"
config ZEPHYR_HAL_ESPRESSIF_MODULE
	bool
	default y

config ZEPHYR_HAL_ESPRESSIF_MODULE_BLOBS
	bool
endmenu
config ZEPHYR_XTENSA_MODULE
	bool
	default y
```

## experiments/zephyr-tone/build-right/Kconfig/boards/Kconfig.defconfig
```kconfig
# Load Zephyr board defconfig descriptions.
osource "/Users/avner/Documents/Projects/ESP32Projects/radiohead/.pio/zephyr-tone-env/workspace/zephyr/boards/espressif/esp32s3_devkitc/Kconfig.defconfig"
```

## experiments/zephyr-tone/build-right/Kconfig/boards/Kconfig.esp32s3_devkitc
```kconfig
# Load board Kconfig descriptions.
osource "/Users/avner/Documents/Projects/ESP32Projects/radiohead/.pio/zephyr-tone-env/workspace/zephyr/boards/espressif/esp32s3_devkitc/Kconfig.esp32s3_devkitc"
```

## experiments/zephyr-tone/build/Kconfig/arch/Kconfig
```kconfig
# Load Zephyr Arch Kconfig descriptions.
osource "/Users/avner/Documents/Projects/ESP32Projects/radiohead/.pio/zephyr-tone-env/workspace/zephyr/arch/rx/Kconfig"
osource "/Users/avner/Documents/Projects/ESP32Projects/radiohead/.pio/zephyr-tone-env/workspace/zephyr/arch/x86/Kconfig"
osource "/Users/avner/Documents/Projects/ESP32Projects/radiohead/.pio/zephyr-tone-env/workspace/zephyr/arch/xtensa/Kconfig"
osource "/Users/avner/Documents/Projects/ESP32Projects/radiohead/.pio/zephyr-tone-env/workspace/zephyr/arch/sparc/Kconfig"
osource "/Users/avner/Documents/Projects/ESP32Projects/radiohead/.pio/zephyr-tone-env/workspace/zephyr/arch/riscv/Kconfig"
osource "/Users/avner/Documents/Projects/ESP32Projects/radiohead/.pio/zephyr-tone-env/workspace/zephyr/arch/posix/Kconfig"
osource "/Users/avner/Documents/Projects/ESP32Projects/radiohead/.pio/zephyr-tone-env/workspace/zephyr/arch/mips/Kconfig"
osource "/Users/avner/Documents/Projects/ESP32Projects/radiohead/.pio/zephyr-tone-env/workspace/zephyr/arch/arm64/Kconfig"
osource "/Users/avner/Documents/Projects/ESP32Projects/radiohead/.pio/zephyr-tone-env/workspace/zephyr/arch/arm/Kconfig"
osource "/Users/avner/Documents/Projects/ESP32Projects/radiohead/.pio/zephyr-tone-env/workspace/zephyr/arch/arc/Kconfig"
```
